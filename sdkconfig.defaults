## sdkconfig.defaults
```kconfig
CONFIG_FATFS_LONG_FILENAMES=y
CONFIG_ESPTOOLPY_FLASHSIZE_4MB=y

CONFIG_ESP_SYSTEM_PANIC_PRINT_HALT=y
CONFIG_LOG_DEFAULT_LEVEL_WARN=y

# Use a custom partition table
CONFIG_PARTITION_TABLE_CUSTOM=y
CONFIG_PARTITION_TABLE_CUSTOM_FILENAME="partitions.csv"
CONFIG_PARTITION_TABLE_FILENAME="partitions.csv"
CONFIG_PARTITION_TABLE_OFFSET=0x10000

 # HTTP config
CONFIG_HTTPD_MAX_REQ_HDR_LEN=1024
CONFIG_HTTPD_MAX_URI_LEN=256
CONFIG_HTTPD_LOG_PURGE_DATA=y
CONFIG_HTTPD_WS_SUPPORT=y

CONFIG_ETH_ENABLED=n

CONFIG_LWIP_LOCAL_HOSTNAME="esp3d-printer"
CONFIG_LWIP_DHCPS=n
CONFIG_LWIP_IPV6=n

CONFIG_ESPTOOLPY_FLASHFREQ_40M=y
CONFIG_ESPTOOLPY_FLASHMODE_QIO=y

# Enable SPI RAM as it is in ESP32-CAM module
CONFIG_SPIRAM=y
CONFIG_SPIRAM_SPEED_40M=y
CONFIG_SPIRAM_USE_MEMMAP=y
CONFIG_SPIRAM_USE_CAPS_ALLOC=y
CONFIG_SPIRAM_USE_MALLOC=n

CONFIG_SPI_MASTER_IN_IRAM=y
CONFIG_UART_ISR_IN_IRAM=y
CONFIG_SCCB_HARDWARE_I2C_PORT0=n
CONFIG_SCCB_HARDWARE_I2C_PORT1=n
```
